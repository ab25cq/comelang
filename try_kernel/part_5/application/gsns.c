/*
 *    ジェスチャーセンサー制御タスク
*/
#include <trykernel.h>
#include "app.h"

void task_gsns(INT stacd, void *exinf);             // タスクの実行関数
UW  tskstk_gsns[1024/sizeof(UW)];                   // タスクのスタック領域
ID  tskid_gsns;                                     // タスクID

/* タスク生成情報 */
T_CTSK  ctsk_gsns = {
    .tskatr     = TA_HLNG | TA_RNG3 | TA_USERBUF,   // タスク属性
    .task       = task_gsns,                        // タスクの実行関数
    .itskpri    = 10,                               // タスク優先度
    .stksz      = sizeof(tskstk_gsns),              // スタックサイズ
    .bufptr     = tskstk_gsns,                      // スタックへのポインタ
};

#define	I2C_SADR			        (0x73)          // センサーのスレーブアドレス
#define	PAJ7620_REG_BANK_SEL		(0xEF)          // バンクレジスタ
#define	PAJ7620_GES_PS_DET_FLAG_0	(0x43)          // データレジスタ

/* センサー内レジスタのリード */
static ER read_sns_reg(ID dd, UW sadr, UW radr, UB *data)
{
    T_I2C_EXEC  exec;
    UB          sbuf;
    ER          err;

    sbuf = (UB)radr;

    exec.sadr = sadr;
    exec.sbuf = &sbuf;
    exec.rbuf = data;

    err = tk_swri_dev(dd, TDN_I2C_EXEC, &exec, sizeof(exec), NULL);

    return err;
}

/* センサー内レジスタへのライト */
static ER write_sns_reg(ID dd, UW sadr, UW radr, UB data)
{
    UB	sbuf[2];
    ER	err;

    sbuf[0] = radr;
    sbuf[1] = data;

    err = tk_swri_dev(dd, sadr, sbuf, sizeof(sbuf), NULL);

    return err;
}

/* ジェスチャーセンサー 初期化 */
/* レジスタ初期化データ*/
typedef struct {
    UB	addr;
    UB	data;
} T_REG;

static T_REG init_reg_tbl[] = {	
    {0xEF,0x00},{0x32,0x29},{0x33,0x01},{0x34,0x00},{0x35,0x01},{0x36,0x00},{0x37,0x07},{0x38,0x17},{0x39,0x06},{0x3A,0x12},{0x3F,0x00},
    {0x40,0x02},{0x41,0xFF},{0x42,0x01},{0x46,0x2D},{0x47,0x0F},{0x48,0x3C},{0x49,0x00},{0x4A,0x1E},{0x4B,0x00},{0x4C,0x20},{0x4D,0x00},
    {0x4E,0x1A},{0x4F,0x14},{0x50,0x00},{0x51,0x10},{0x52,0x00},{0x5C,0x02},{0x5D,0x00},{0x5E,0x10},{0x5F,0x3F},{0x60,0x27},{0x61,0x28},
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    {0x71,0x00},{0x72,0x01},{0x73,0x35},{0x74,0x00},{0x75,0x33},{0x76,0x31},{0x77,0x01},{0x7C,0x84},{0x7D,0x03},{0x7E,0x01},
};

static ER init_gsns(ID dd)
{
    T_REG	*p_tbl;
    ER      err;

    p_tbl = init_reg_tbl;
    for(INT	i = 0; i < (sizeof(init_reg_tbl)/sizeof(T_REG)); p_tbl++, i++) {
        err = write_sns_reg(dd_i2c0, I2C_SADR, p_tbl->addr, p_tbl->data);
     if(err < E_OK) return err;
    }

    err = write_sns_reg(dd_i2c0, I2C_SADR, PAJ7620_REG_BANK_SEL, 0);
    if(err < E_OK) err = write_sns_reg(dd_i2c0, I2C_SADR, PAJ7620_REG_BANK_SEL, 0);

    return err;
}

/* タスクの実行関数*/
void task_gsns(INT stacd, void *exinf)
{
    UB  data, pre_data;
    ER  err;

    err = init_gsns(dd_i2c0);                     // ジェスチャーセンサーの初期化
    if(err < E_OK) tm_putstring("ERROR GSNS init\n");

    gsns_data = pre_data = 0;
    while(1) {
        err = read_sns_reg(dd_i2c0, I2C_SADR, PAJ7620_GES_PS_DET_FLAG_0, &data);    // センサーデータの取得
        if(err >= E_OK) {
            if((data != pre_data) && (data != 0)) {
                tm_putstring("sns!\n");
                gsns_data = (UW)data;                       // グローバル変数の更新
                tk_set_flg(flgid_1, FLG_GSNS);              // イベントフラグのセット
                pre_data = data;
            }
        } else {
            tm_putstring("ERROR Read GSNS\n");
        }
        tk_dly_tsk(200);                                    // 0.2秒間待ち状態に
    }
}
